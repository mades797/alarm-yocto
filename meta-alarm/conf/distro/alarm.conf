## meta-alarm/conf/distro/alarm.conf
```bitbake
require conf/distro/poky.conf


INIT_MANAGER = "systemd"
DISTRO_FEATURES:append = " usrmerge systemd bluez5 bluetooth wifi grep cpufrequtils wpa-supplicant"
DISTRO_FEATURES:remove = " sysvinit"
VIRTUAL-RUNTIME_syslog = ""
VIRTUAL-RUNTIME_base-utils-syslog = ""
DISTRO_FEATURES:remove = "wayland"
DISTRO_FEATURES:append = "systemd"
DISTRO_FEATURES:append = "ssh-server-openssh"
LICENSE_FLAGS_ACCEPTED = "synaptics-killswitch"
```

## meta-alarm/conf/layer.conf
```bitbake
# We have a conf and classes directory, add to BBPATH
BBPATH .= ":${LAYERDIR}"

# We have recipes-* directories, add to BBFILES
BBFILES += "${LAYERDIR}/recipes-*/*/*.bb \
            ${LAYERDIR}/recipes-*/*/*.bbappend"

BBFILE_COLLECTIONS += "meta-alarm"
BBFILE_PATTERN_meta-alarm = "^${LAYERDIR}/"
BBFILE_PRIORITY_meta-alarm = "6"

LAYERDEPENDS_meta-alarm = "core"
LAYERSERIES_COMPAT_meta-alarm = "scarthgap"
```
